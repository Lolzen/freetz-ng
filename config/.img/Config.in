## make/libs/cairo/Config.in
```kconfig
config FREETZ_LIB_libcairo
	bool "Cairo (libcairo.so)"
	depends on FREETZ_TARGET_GCC_4_7_MIN
	select FREETZ_LIB_libpixman_1
	select FREETZ_LIB_libfontconfig
	select FREETZ_LIB_libfreetype
	select FREETZ_LIB_libpng16
	select FREETZ_LIB_libz
	default n
	help
		Cairo is a 2D graphics library with support for multiple output devices.
		Cairo is designed to produce consistent output on all output media while
		taking advantage of display hardware acceleration when available.
```

## make/pkgs/celllock/Config.in
```kconfig
config FREETZ_PACKAGE_CELLLOCK_CGI
	bool "Cell Lock WebGUI for Quectel RM500Q-AE"
	default n
	help
		Web configuration interface for Quectel RM500Q-AE on the Fritzbox 6850 5Gv1
		to send signal codes. (for example a cell lock)
```

## make/pkgs/fontconfig/Config.in
```kconfig
config FREETZ_PACKAGE_FONTCONFIG
	bool "Fontconfig 2.17.1/2.18.3 (binary only)"
	depends on FREETZ_LIB_libfontconfig
	default n
	help
		Fontconfig is a library for configuring and customizing
		font access. This package adds /etc/fontsfonts.conf

if FREETZ_PACKAGE_FONTCONFIG

	choice
		prompt "Version"
			default FREETZ_PACKAGE_FONTCONFIG_VERSION_CURRENT

		config FREETZ_PACKAGE_FONTCONFIG_VERSION_ABANDON
			bool "2.17.1"
			depends on FREETZ_LIB_libfontconfig_WITH_VERSION_ABANDON

		config FREETZ_PACKAGE_FONTCONFIG_VERSION_CURRENT
			bool "2.18.3"
			depends on FREETZ_LIB_libfontconfig_WITH_VERSION_CURRENT

	endchoice

endif # FREETZ_PACKAGE_FONTCONFIG
```

## make/pkgs/pcsc-lite/Config.in
```kconfig
config FREETZ_PACKAGE_PCSC_LITE
	bool "PCSC-lite 1.9.5/2.5.1 (binary only)"
	select FREETZ_LIB_libdl       if FREETZ_TARGET_UCLIBC_HAS_multiple_libs
	select FREETZ_LIB_libpthread  if FREETZ_TARGET_UCLIBC_HAS_multiple_libs
	select FREETZ_LIB_librt       if FREETZ_TARGET_UCLIBC_HAS_multiple_libs
	select FREETZ_LIB_libusb1
	select FREETZ_LIB_libpcsclite # loaded per dlopen
	default n
	help
		The purpose of PCSC Lite is to provide a Windows(R)
		SCard interface in a very small form factor for
		communicating to smart cards and readers.

if FREETZ_PACKAGE_PCSC_LITE

	choice
		prompt "Version"
			default FREETZ_PACKAGE_PCSC_LITE_VERSION_CURRENT

		config FREETZ_PACKAGE_PCSC_LITE_VERSION_ABANDON
			bool "1.9.5"
			depends on FREETZ_LIB_libpcsclite_WITH_VERSION_ABANDON

		config FREETZ_PACKAGE_PCSC_LITE_VERSION_CURRENT
			bool "2.5.1"
			depends on FREETZ_LIB_libpcsclite_WITH_VERSION_CURRENT

	endchoice

endif # FREETZ_PACKAGE_PCSC_LITE
```

## make/pkgs/smartmontools/Config.in
```kconfig
config FREETZ_PACKAGE_SMARTMONTOOLS
	bool "Smartmontools 7.2/7.5"
	select FREETZ_STDCXXLIB_FORCE_GNULIBSTDCXX
	select FREETZ_LIB_STDCXXLIB
	default n
	help
		Smartmontools contains utility programs (smartctl, smartd) to
		control/monitor storage systems using the Self-Monitoring, Analysis
		and Reporting Technology System (S.M.A.R.T.) built into most modern
		ATA and SCSI disks. It is derived from smartsuite.

if FREETZ_PACKAGE_SMARTMONTOOLS

	choice
		prompt "Version"
			default FREETZ_PACKAGE_SMARTMONTOOLS_VERSION_CURRENT

		config FREETZ_PACKAGE_SMARTMONTOOLS_VERSION_ABANDON
			bool "7.2"
			depends on (FREETZ_KERNEL_VERSION_2_6_39 || !FREETZ_TARGET_GCC_4_7_MIN)

		config FREETZ_PACKAGE_SMARTMONTOOLS_VERSION_CURRENT
			bool "7.5"
			depends on !(FREETZ_KERNEL_VERSION_2_6_39 || !FREETZ_TARGET_GCC_4_7_MIN)

	endchoice

endif # FREETZ_PACKAGE_SMARTMONTOOLS
```
